## conf/layer.conf
```bitbake
BBPATH =. "${LAYERDIR}:"

BBFILES += "\
            ${LAYERDIR}/recipes-dca/*/*.bb \
            ${LAYERDIR}/recipes-dca/*/*.bbappend \
           "

## Conditionally include recipes based on distro
BBFILES += "\
            ${LAYERDIR}/dynamic-distro/${DISTRO}/*/*.bb \
            ${LAYERDIR}/dynamic-distro/${DISTRO}/*/*.bbappend \
           "

BBFILE_COLLECTIONS += "meta-dca"
BBFILE_PATTERN_meta-dca = "^${LAYERDIR}/"
BBFILE_PRIORITY_meta-dca = "8"

LAYERVERSION_meta-dca = "1"
LAYERDEPENDS_meta-dca = "\
                          clang-layer \
                          core \
                          meta-sca \
                          openembedded-layer \
                         "
DCA_LAYERDIR = "${LAYERDIR}"

LAYERSERIES_COMPAT_meta-dca = "gatesgarth"

INHERIT += "dca-sanitychecks dca-recipe-backtrack"
```
